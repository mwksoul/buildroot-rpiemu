## configs/rpiemu_defconfig
```kconfig
BR2_arm=y
BR2_arm1176jzf_s=y

BR2_GCC_VERSION_4_9_X=y
BR2_BINUTILS_VERSION_2_25=y
BR2_KERNEL_HEADERS_3_18=y

BR2_OPTIMIZE_3=y
BR2_GCC_ENABLE_OPENMP=y
BR2_GCC_ENABLE_GRAPHITE=y

BR2_EXTRA_GCC_CONFIG_OPTIONS="--with-float=hard --with-fpu=vfp"
BR2_TARGET_OPTIMIZATION="-Ofast -fno-fast-math -pipe -mcpu=arm1176jzf-s -mtune=arm1176jzf-s -mfloat-abi=hard -mfpu=vfp"

BR2_TOOLCHAIN_BUILDROOT_LARGEFILE=y
BR2_TOOLCHAIN_BUILDROOT_MUSL=y
BR2_TOOLCHAIN_BUILDROOT_CXX=y

BR2_ENABLE_LOCALE_PURGE=y
BR2_ENABLE_LOCALE_WHITELIST="C en_US"

BR2_TARGET_GENERIC_HOSTNAME="rpi"
BR2_TARGET_GENERIC_ISSUE="Welcome to Raspberry Pi"
BR2_TARGET_GENERIC_PASSWD_SHA256=y
BR2_TARGET_GENERIC_GETTY_PORT="tty1"

BR2_TARGET_ROOTFS_TAR_XZ=y
BR2_ROOTFS_DEVICE_CREATION_DYNAMIC_MDEV=y

BR2_LINUX_KERNEL=y
BR2_LINUX_KERNEL_CUSTOM_GIT=y
BR2_LINUX_KERNEL_CUSTOM_REPO_URL="git://github.com/raspberrypi/linux.git"
BR2_LINUX_KERNEL_CUSTOM_REPO_VERSION="rpi-3.18.y"
BR2_LINUX_KERNEL_USE_CUSTOM_CONFIG=y
BR2_LINUX_KERNEL_CUSTOM_CONFIG_FILE="board/raspberrypi/linux-3.18-rpi-dt.defconfig"
BR2_LINUX_KERNEL_ZIMAGE=y

BR2_PACKAGE_RPI_FIRMWARE=y
BR2_PACKAGE_RPI_USERLAND=y
BR2_PACKAGE_DROPBEAR=y
BR2_PACKAGE_ZLIB=y
BR2_PACKAGE_ALSA_LIB=y
BR2_PACKAGE_FREETYPE=y
BR2_PACKAGE_RETROARCH=y
```
